## src/bakar/overlays/meta-bakar-cache-classify/conf/layer.conf
```bitbake
# meta-bakar-cache-classify: bakar-provided layer carrying the cache-visibility
# classification bbclass.
#
# bakar materializes this layer into <bsp_root>/.bakar/meta-bakar-cache-classify
# and the cache-classify tuning overlay (bakar-tuning-cache-classify.yml) adds it
# via kas `repos:`. It carries the bitbake class that classifies recipes by their
# cache visibility so the build UI can surface cache hit/miss state.

# Make the layer's recipes/bbappends visible.
BBPATH .= ":${LAYERDIR}"
BBFILES += "${LAYERDIR}/recipes-*/*/*.bb ${LAYERDIR}/recipes-*/*/*.bbappend"

BBFILE_COLLECTIONS += "cache-classify"
BBFILE_PATTERN_cache-classify = "^${LAYERDIR}/"
BBFILE_PRIORITY_cache-classify = "20"

LAYERVERSION_cache-classify = "1"
LAYERDEPENDS_cache-classify = "core"
LAYERSERIES_COMPAT_cache-classify = "kirkstone scarthgap styhead walnascar wrynose"
```

## src/bakar/overlays/meta-bakar-host/conf/layer.conf
```bitbake
# meta-bakar-host: bakar-provided layer carrying host-mode build fixes.
#
# bakar materializes this layer into <bsp_root>/.bakar/meta-bakar-host and the
# host tuning overlay (bakar-tuning-host.yml) adds it via kas `repos:`, but only
# when the resolved build runs in host mode. It currently carries one bbappend
# (rpm) that neutralises the rpm transaction plugins so rpm-native does not
# dlopen the build host's ABI-incompatible /usr/lib/rpm-plugins during do_rootfs;
# see recipes-devtools/rpm/rpm_%.bbappend.

# Make the layer's recipes/bbappends visible.
BBPATH .= ":${LAYERDIR}"
BBFILES += "${LAYERDIR}/recipes-*/*/*.bb ${LAYERDIR}/recipes-*/*/*.bbappend"

BBFILE_COLLECTIONS += "bakar-host"
BBFILE_PATTERN_bakar-host = "^${LAYERDIR}/"
BBFILE_PRIORITY_bakar-host = "20"

LAYERVERSION_bakar-host = "1"
LAYERDEPENDS_bakar-host = "core"
LAYERSERIES_COMPAT_bakar-host = "kirkstone scarthgap styhead walnascar wrynose"
```

## src/bakar/overlays/meta-bakar-mold/conf/layer.conf
```bitbake
# meta-bakar-mold: ships the mold linker recipe and mold.bbclass.
#
# bakar materializes this layer into <bsp_root>/.bakar/meta-bakar-mold and the
# mold tuning overlay adds it via kas `repos:`. Unlike meta-bakar-sccache, this
# layer carries a from-scratch mold recipe; compat was originally pinned to
# wrynose-only during planning, but the wrynose tree isn't stood up yet, so
# E2E testing starts on the existing scarthgap tree instead. Verified before
# widening: scarthgap's gcc_13.4.bb clears the >=12.1 floor -fuse-ld=mold
# needs and is fully C++20-capable for mold-native's CMake build.

# Make classes/ visible to INHERIT.
BBPATH .= ":${LAYERDIR}"

# Register the recipes this layer ships.
BBFILES += "${LAYERDIR}/recipes-*/*/*.bb ${LAYERDIR}/recipes-*/*/*.bbappend"

BBFILE_COLLECTIONS += "meta-bakar-mold"
BBFILE_PATTERN_meta-bakar-mold = "^${LAYERDIR}/"
BBFILE_PRIORITY_meta-bakar-mold = "20"

LAYERVERSION_meta-bakar-mold = "1"
LAYERDEPENDS_meta-bakar-mold = "core"
LAYERSERIES_COMPAT_meta-bakar-mold = "scarthgap wrynose"
```

## src/bakar/overlays/meta-bakar-sccache/conf/layer.conf
```bitbake
# meta-bakar-sccache: a class-only layer that ships sccache.bbclass.
#
# bakar materializes this layer into <bsp_root>/.bakar/meta-bakar-sccache and
# the sccache tuning overlay adds it via kas `repos:`. It carries no recipes -
# only classes/sccache.bbclass - so its layer compatibility is intentionally
# broad.

# Make classes/ visible to INHERIT.
BBPATH .= ":${LAYERDIR}"

BBFILE_COLLECTIONS += "bakar-sccache"
BBFILE_PATTERN_bakar-sccache = "^${LAYERDIR}/"
BBFILE_PRIORITY_bakar-sccache = "20"

LAYERVERSION_bakar-sccache = "1"
LAYERDEPENDS_bakar-sccache = "core"
LAYERSERIES_COMPAT_bakar-sccache = "kirkstone scarthgap styhead walnascar wrynose"
```
